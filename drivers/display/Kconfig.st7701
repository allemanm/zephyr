## drivers/display/Kconfig.st7701
```kconfig
# Copyright (c) 2025 Arduino SA
# SPDX-License-Identifier: Apache-2.0

config ST7701
	bool "ST7701 display controller driver"
	default y
	depends on DT_HAS_SITRONIX_ST7701_ENABLED
	select GPIO
	select MIPI_DSI if $(dt_compat_on_bus,$(DT_COMPAT_SITRONIX_ST7701),mipi-dsi)
	select SPI if $(dt_compat_on_bus,$(DT_COMPAT_SITRONIX_ST7701),spi)
	help
	  Enable driver for ST7701 display driver.
```

## dts/bindings/display/sitronix,st7701-mipi.yaml
```yaml
# Copyright (c) 2025 Arduino SA
# SPDX-License-Identifier: Apache-2.0

title: Sitronix ST7701 display controller

description: |
    The Sitronix ST7701 is a 16.7M colors TFT-LCD controller
    with a maximum 480RGBx864 resolution.

compatible: "sitronix,st7701"

include: ["sitronix,st7701-common.yaml", mipi-dsi-device.yaml]
```

## dts/bindings/display/sitronix,st7701-spi.yaml
```yaml
# Copyright (c) 2025 Arduino SA
# SPDX-License-Identifier: Apache-2.0

title: Sitronix ST7701 display controller

description: |
    The Sitronix ST7701 is a 16.7M colors TFT-LCD controller
    with a maximum 480RGBx864 resolution.

compatible: "sitronix,st7701"

include: ["sitronix,st7701-common.yaml", spi-device.yaml]

properties:
  pixel-format:
    type: int
    required: true
    description:
      Pixel format. Available formats in dt-bindings/mipi_dsi/mipi_dsi.h.
```
