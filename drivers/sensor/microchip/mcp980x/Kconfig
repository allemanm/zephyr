## drivers/sensor/microchip/mcp980x/Kconfig
```kconfig
# MCP980X temperature sensor configuration options

# Copyright (c) 2024 Basalte bv
# Copyright (c) 2016 Intel Corporation
# SPDX-License-Identifier: Apache-2.0

menuconfig MCP980X
	bool "MCP980X temperature sensor"
	default y
	depends on DT_HAS_MICROCHIP_MCP980X_ENABLED
	select I2C
	help
	  Enable driver for MCP980X temperature sensor.

if MCP980X

choice
	prompt "MCP980X trigger mode"
	default MCP980X_TRIGGER_NONE

config MCP980X_TRIGGER_NONE
	bool "No trigger"

config MCP980X_TRIGGER_GLOBAL_THREAD
	depends on GPIO
	select MCP980X_TRIGGER
	bool "Use global thread"

config MCP980X_TRIGGER_OWN_THREAD
	depends on GPIO
	select MCP980X_TRIGGER
	bool "Use own thread"

endchoice

config MCP980X_TRIGGER
	bool

config MCP980X_THREAD_STACK_SIZE
	int "Sensor thread stack size"
	depends on MCP980X_TRIGGER_OWN_THREAD
	default 1024

config MCP980X_THREAD_PRIORITY
	int "MCP980X thread priority"
	depends on MCP980X_TRIGGER_OWN_THREAD
	default 10

endif # MCP980X
```

## dts/bindings/sensor/microchip,mcp9800.yaml
```yaml
# Copyright (c) 2019, Linaro Limited
# SPDX-License-Identifier: Apache-2.0

description: |
    Microchip MCP9800 Digital Temperature Sensor. See
    http://ww1.microchip.com/downloads/en/DeviceDoc/25095A.pdf.

compatible: "microchip,mcp9800"

include: ["microchip,mcp980x.yaml"]
```

## dts/bindings/sensor/microchip,mcp980x.yaml
```yaml
# Copyright (c) 2024, Basalte bv
# Copyright (c) 2024, Linaro Limited
# SPDX-License-Identifier: Apache-2.0

description: |
    Microchip MCP9800/9801/9802/9803 Digital Temperature Sensor. See
    https://ww1.microchip.com/downloads/en/DeviceDoc/21909d.pdf.

include: ["microchip,mcp9808.yaml"]

compatible: "microchip,mcp980x"
```
